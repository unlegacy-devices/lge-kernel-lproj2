## arch/arm/mach-msm/lge/e0/Kconfig
```kconfig
config MACH_MSM7X25A_E0EU
    depends on ARCH_MSM7X27A
    depends on !MSM_STACKED_MEMORY
    select MACH_LGE
    bool "MSM7x25A E0"
    help
        Support for the LG Electronics MSM7x25A E0.
```

## drivers/staging/volans/Kconfig
```kconfig
comment "Qualcomm Atheros Volans WLAN module"
config VOLANS_WLAN
	tristate "Qualcomm Atheros Volans WLAN module"
	default n
	help
	Add support for the Qualcomm Atheros Volans WLAN module

#	depends on WLAN
#	depends on CFG80211
#        depends on LIBRA_SDIOIF
```
